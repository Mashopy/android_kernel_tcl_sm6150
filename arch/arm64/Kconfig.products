## arch/arm64/Kconfig.products
```kconfig
menu "Products selection"
config TCT_SM6150_COMMON
	bool "SM6150 TCT COMMON CONFIG"
	depends on ARCH_SM6150
	help
	  Support for TCT common device configration.

config TCT_SM6150_T1
	bool "SM6150 TCT T1"
	depends on ARCH_SM6150
	help
	  Support for TCT T1 device.

config TCT_SM6150_T1_PRO
        bool "SM6150 TCT T1 PRO"
        depends on ARCH_SM6150
        help
          Support for TCT T1 PRO device.
endmenu
```

## drivers/nfc/st21nfcd/Kconfig
```kconfig
config NFC_ST21NFCD
	bool "ST ST21NFCD NFC SUPPORT"
	default n
	---help---
	  STMicroelectronics ST21NFCD core driver. It implements the chipset
	  HCI logic and hooks into the NFC kernel APIs. Physical layers will
	  register against it.
	  Say N if unsure.
```
