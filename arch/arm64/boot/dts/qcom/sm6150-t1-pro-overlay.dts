/* Copyright (C) 2019 Tcl Corporation Limited */
/* Copyright (c) 2018, The Linux Foundation. All rights reserved.
 *
 * This program is free software; you can redistribute it and/or modify
 * it under the terms of the GNU General Public License version 2 and
 * only version 2 as published by the Free Software Foundation.
 *
 * This program is distributed in the hope that it will be useful,
 * but WITHOUT ANY WARRANTY; without even the implied warranty of
 * MERCHANTABILITY or FITNESS FOR A PARTICULAR PURPOSE.  See the
 * GNU General Public License for more details.
 */

/dts-v1/;
/plugin/;

#include <dt-bindings/interrupt-controller/arm-gic.h>
#include <dt-bindings/clock/qcom,camcc-sm6150.h>

#include "sm6150-audio-overlay.dtsi"
#include "sm6150-t1pro.dtsi"

/ {
	model = "T1 PRO";
	compatible = "qcom,sm6150-mtp", "qcom,sm6150", "qcom,mtp";
	qcom,board-id = <8 1>;
};
