/* Copyright (c) 2018, The Linux Foundation. All rights reserved.
 *
 * This program is free software; you can redistribute it and/or modify
 * it under the terms of the GNU General Public License version 2 and
 * only version 2 as published by the Free Software Foundation.
 *
 * This program is distributed in the hope that it will be useful,
 * but WITHOUT ANY WARRANTY; without even the implied warranty of
 * MERCHANTABILITY or FITNESS FOR A PARTICULAR PURPOSE.  See the
 * GNU General Public License for more details.
 */

&mdss_mdp {
	dsi_t1_pro_cmd: qcom,mdss_dsi_t1_pro_cmd {
		qcom,mdss-dsi-panel-name =
			"t1 pro cmd mode amoled dsi panel";
		qcom,mdss-dsi-panel-type = "dsi_cmd_mode";

		qcom,mdss-dsi-virtual-channel-id = <0>;
		qcom,mdss-dsi-stream = <0>;
		qcom,mdss-dsi-h-left-border = <0>;
		qcom,mdss-dsi-h-right-border = <0>;
		qcom,mdss-dsi-v-top-border = <0>;
		qcom,mdss-dsi-v-bottom-border = <0>;
		qcom,mdss-dsi-bpp = <24>;
		qcom,mdss-dsi-color-order = "rgb_swap_rgb";
		qcom,mdss-dsi-underflow-color = <0xff>;
		qcom,mdss-dsi-border-color = <0>;
		qcom,mdss-dsi-h-sync-pulse = <0>;
		qcom,mdss-dsi-traffic-mode = "burst_mode";
		qcom,mdss-dsi-lane-map = "lane_map_0123";
		qcom,mdss-dsi-bllp-eof-power-mode;
		qcom,mdss-dsi-bllp-power-mode;
		qcom,mdss-dsi-tx-eot-append;
		qcom,mdss-dsi-lane-0-state;
		qcom,mdss-dsi-lane-1-state;
		qcom,mdss-dsi-lane-2-state;
		qcom,mdss-dsi-lane-3-state;
		qcom,mdss-dsi-dma-trigger = "trigger_sw";
		qcom,mdss-dsi-mdp-trigger = "none";
		//qcom,mdss-dsi-lp11-init;
		qcom,mdss-dsi-bl-pmic-control-type = "bl_ctrl_dcs";
		qcom,mdss-dsi-reset-sequence = <1 5>, <0 10>, <1 10>;
		qcom,mdss-pan-physical-width-dimension = <79>;
		qcom,mdss-pan-physical-height-dimension = <150>;
		qcom,mdss-dsi-te-pin-select = <1>;
		qcom,mdss-dsi-wr-mem-start = <0x2c>;
		qcom,mdss-dsi-wr-mem-continue = <0x3c>;
		qcom,mdss-dsi-te-dcs-command = <1>;
		//qcom,ulps-enabled;
		qcom,mdss-dsi-panel-hdr-enabled;
		qcom,mdss-dsi-panel-hdr-color-primaries = <15400 16350 33300 16650
			11250 35850 6950  2750>;
		qcom,mdss-dsi-display-timings {
			timing@0 {
				qcom,mdss-dsi-panel-width = <1080>;
				qcom,mdss-dsi-panel-height = <2340>;
				qcom,mdss-dsi-h-front-porch = <72>;
				qcom,mdss-dsi-h-back-porch = <64>;
				qcom,mdss-dsi-h-pulse-width = <2>;
				qcom,mdss-dsi-h-sync-skew = <0>;
				qcom,mdss-dsi-v-back-porch = <4>;
				qcom,mdss-dsi-v-front-porch = <8>;
				qcom,mdss-dsi-v-pulse-width = <4>;
				qcom,mdss-dsi-panel-framerate = <60>;
				qcom,mdss-dsi-on-command = [
						15 01 00 00 00 00 02 FE 72
						15 01 00 00 00 00 02 6B 31
						15 01 00 00 00 00 02 B0 09
						15 01 00 00 00 00 02 B1 D0
						15 01 00 00 00 00 02 B2 09
						15 01 00 00 00 00 02 B3 D0
						15 01 00 00 00 00 02 48 00
						15 01 00 00 00 00 02 49 0A
						15 01 00 00 00 00 02 4B 37
						15 01 00 00 00 00 02 AF FF
						15 01 00 00 00 00 02 FE 60
						15 01 00 00 00 00 02 F5 80
						15 01 00 00 00 00 02 FE 40
						15 01 00 00 00 00 02 80 02
						15 01 00 00 00 00 02 74 23
						15 01 00 00 00 00 02 75 00
						15 01 00 00 00 00 02 6A 44
						15 01 00 00 00 00 02 69 04
						15 01 00 00 00 00 02 FE E0
						15 01 00 00 00 00 02 91 23
						15 01 00 00 00 00 02 92 23
						15 01 00 00 00 00 02 93 23
						15 01 00 00 00 00 02 94 23
						15 01 00 00 00 00 02 95 19
						15 01 00 00 00 00 02 96 19
						15 01 00 00 00 00 02 97 19
						15 01 00 00 00 00 02 98 19
						15 01 00 00 00 00 02 99 19
						15 01 00 00 00 00 02 FE D0
						15 01 00 00 00 00 02 42 01
						15 01 00 00 00 00 02 49 03
						15 01 00 00 00 00 02 FE 40
						15 01 00 00 00 00 02 4D 00
						15 01 00 00 00 00 02 FE 00
						39 01 00 00 00 00 05 2A 00 00 04 37
						39 01 00 00 00 00 05 2B 00 00 09 23
						15 01 00 00 00 00 02 C2 08
						15 01 00 00 00 00 02 35 00
						39 01 00 00 00 00 03 51 00 00
						05 01 00 00 3c 00 01 11
						05 01 00 00 00 00 01 29
					];
				qcom,mdss-dsi-off-command = [
						05 01 00 00 32 00 02 28 00
						05 01 00 00 5a 00 02 10 00
					];
				iris,abyp-panel-command = [
						39 01 00 00 00 00 05 2A 00 00 04 37
						39 01 00 00 00 00 05 2B 00 00 09 23
					];
				qcom,mdss-dsi-on-command-state = "dsi_lp_mode";
				qcom,mdss-dsi-off-command-state = "dsi_hs_mode";
				iris,abyp-panel-command-state = "dsi_lp_mode";
				qcom,mdss-dsi-abyp-on-command-state = "dsi_lp_mode";
				/* MODIFIED-BEGIN by hongwei.tian, 2019-09-26,BUG-8385564*/
				qcom,mdss-dsi-lp1-command = [
						15 01 00 00 00 00 02 FE 00
						15 01 00 00 00 00 02 39 00
					];
				qcom,mdss-dsi-lp2-command = [
						15 01 00 00 00 00 02 FE 00
						15 01 00 00 00 00 02 39 00
					];
				qcom,mdss-dsi-lp1-command-state = "dsi_lp_mode";
				qcom,mdss-dsi-lp2-command-state = "dsi_lp_mode";
				qcom,mdss-dsi-nolp-command = [
						15 01 00 00 00 00 02 FE 00
						15 01 00 00 00 00 02 38 00
					];
				qcom,mdss-dsi-nolp-command-state = "dsi_lp_mode";
				/* MODIFIED-END by hongwei.tian,BUG-8385564*/
			};
		};
	};
};
